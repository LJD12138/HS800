/*******************************************************************************************************************************
 * Project : APP
 * Module  : APP\ComFunc
 * File    : ntc.c
 * Date    : 2026-09-20
 * Author  : LJD(291483914@qq.com)
 * Desc    : NTC 阻值查表与温度计算实现
 * -------------------------------------------------------
 * todo    :
 * 1. none
 * -------------------------------------------------------
 * Copyright (c) 2026 -inc
 *******************************************************************************************************************************/

//****************************************************Includes******************************************************************//
#include "ntc.h"
#include "function.h"

#if (1)
//****************************************************Macros********************************************************************//

//****************************************************Parameter Initialization**************************************************//

#if (0)
/* 冗余阻值表隔离，工程当前采用 adc_task.c Q8 查表算法计算温度 */
const u32 ula10K_B3950_RES_TABLE[ntc10K_B3950_RES_TABLE_SIZE] =
{
    336500, 314400, 293900, 274800, 257100, 240600, 225300, 211000, 197800, 185400,
    173900, 163200, 153200, 143900, 135200, 127100, 119500, 112400, 105800, 99610,
    93830,  88420,  83360,  78610,  74170,  70000,  66090,  62420,  58970,  55730,
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    442,    430,    418,    407,    396,    386,    376,    366,    357,    348,
    339
};

const u32 ula100K_B3950_RES_TABLE[ntc100K_B3950_RES_TABLE_SIZE] =
{
    3365000, 3144000, 2939000, 2748000, 2571000, 2406000, 2253000, 2110000, 1978000, 1854000,
    1739000, 1632000, 1532000, 1439000, 1352000, 1271000, 1195000, 1124000, 1058000, 996100,
    938300,  884200,  833600,  786100,  741700,  700000,  660900,  624200,  589700,  557300,
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    4420,    4300,    4180,    4070,    3960,    3860,    3760,    3660,    3570,    3480,
    3390
};
#endif

/* ---------------------------------------------------------------------------------------------------------------------
 * NTC 温度拟合定点查找表 (Q8 格式: 真实值 * 256)
 * 对应原式 T = 307 - 37 * ln(AD)，步长为 64 (覆盖 AD 0 ~ 4096，共 65 个节点)
 * 在 Cortex-M4 下通过单周期纯整数乘法插值即可完成高精计算，完全消除 log 浮点库
 * --------------------------------------------------------------------------------------------------------------------- */
static const int16_t s_sa_adc_temp_lut_q8[65] =
{
	32634,  32634,  32634,  28793,  26068,  23954,  22228,  20767,
	19503,  18387,  17389,  16486,  15662,  14904,  14202,  13548,
	12937,  12363,  11821,  11309,  10823,  10361,   9921,   9500,
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	 1071,    903,    739,    577,    417,    261,    107,    -45,
	 -194
};

/***********************************************************************************************************************
 * 函数功能    : 初始化 NTC 配置参数
 * 说明(备注)  : 配置 NTC 额定电阻与分压比
 * 传入参数    : p_val: 配置句柄; sys_vol: 系统基准电压; volt_res: 分压电阻; ntc_res: 额定电阻; hex_x: ADC 满量程; b_x: B值
 * 输出参数    : p_val: 初始化后的配置结构体
 * 返回值      : 无
 ************************************************************************************************************************/
void vNtc_Init(ntc_val_t *p_val, float sys_vol, u16 volt_res, u16 ntc_res, u16 hex_x, u16 b_x)
{
    if (p_val == NULL)
        return;

    p_val->sys_vol  = sys_vol;
    p_val->volt_res = volt_res;
    p_val->ntc_res  = ntc_res;
    p_val->hex_x    = hex_x;
    p_val->b_x      = b_x;
}

/***********************************************************************************************************************
 * 函数功能    : 通过电阻值查表获取温度
 * 说明(备注)  : 二分查找单调递减或递增阻值表
 * 传入参数    : p_buff: 表首地址; zero_index_temp: 0下标对应的物理温度; len: 数组长度; res: 测量阻值
 * 输出参数    : 无
 * 返回值      : 计算得到的温度值 (摄氏度)
 ************************************************************************************************************************/
s16 sNtc_GetTempByRes(const u32 *p_buff, const s16 zero_index_temp, const u16 len, const u32 res)
{
    if (p_buff == NULL || len == 0)
        return zero_index_temp;

    return (s16)(usFunc_PositTableU32(p_buff, len, res) + zero_index_temp);
}

/***********************************************************************************************************************
 * 函数功能    : 通过采样 AD 值计算温度 (定点查表线性插值法)
 * 说明(备注)  : 原理对应 T = 307 - 37 * ln(AD)，消除 math.h 对数库调用与除零硬件异常
 * 传入参数    : us_ad_val: 12 位采样 AD 转换值 (0~4095)
 * 输出参数    : 无
 * 返回值      : int16_t: 计算得出的温度值 (单位: 摄氏度, 范围 -128 ~ 127)
 ************************************************************************************************************************/
int16_t sNtc_CalcTempByAd(uint16_t us_ad_val)
{
	int32_t s_idx;
	int32_t s_rem;
	int32_t s_t0;
	int32_t s_t1;
	int32_t s_t_q8;
	int32_t s_temp;

	/* 1. 安全边界检查与极限情况处理 */
	if (us_ad_val <= 129)
		return 127;     /* AD过小或短路，判定为最高保护温标 127 度 */
	if (us_ad_val >= 4080)
		return 0;       /* AD满量程或开路(NTC断线/丢失)，判定为 0 度，触发 NTC 掉线保护 */

	/* 2. 定点查表与线性插值 (步长 64，右移 6 位) */
	s_idx = (int32_t)(us_ad_val >> 6);
	s_rem = (int32_t)(us_ad_val & 63);

	s_t0 = (int32_t)s_sa_adc_temp_lut_q8[s_idx];
	s_t1 = (int32_t)s_sa_adc_temp_lut_q8[s_idx + 1];

	/* 线性插值并四舍五入: T = T0 + (T1 - T0) * rem / 64 */
	s_t_q8 = s_t0 + (((s_t1 - s_t0) * s_rem) >> 6);
	s_temp = (s_t_q8 + 128) >> 8;

	/* 3. 输出门限钳位 */
	if (s_temp > 127)
		s_temp = 127;
	else if (s_temp < -128)
		s_temp = -128;

	return (int16_t)s_temp;
}

#endif  /* 1 */

