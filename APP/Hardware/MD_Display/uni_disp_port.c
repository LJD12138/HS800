/*******************************************************************************************************************************
 * Project : APP
 * Module  : APP\Hardware\MD_Display
 * File    : uni_disp_port.c
 * Date    : 2026-09-16
 * Author  : LJD(291483914@qq.com)
 * Desc    : UniDisplay 移植层实现 - FreeRTOS 任务通知唤醒 + 项目适配原语 (转调项目件)
 * -------------------------------------------------------
 * todo    :
 * 1. 无
 * -------------------------------------------------------
 * Copyright (c) 2026 -inc
 *******************************************************************************************************************************/

//****************************************************Includes******************************************************************//
#include "uni_disp_port.h"

#if (boardDISPLAY_EN)
#include "uni_disp_core.h"      /* ucDisp_DataDevState: 通用层读取设备状态 */
#include "MD_Display/md_display_api.h"
#include "MD_Display/md_display_data.h"     /* 项目页面 ID (overlay 页) */
#include "Middlewares/LVGL/lvgl.h"          /* lv_mem_monitor: 切页后内存审计 */
#include "Print/print_task.h"
#include "app_info.h"
#include "Sys/sys_task.h"

#if (boardBUZ_EN)
#include "Buz/buz_task.h"
#endif  /* boardBUZ_EN */


//****************************************************Macros********************************************************************//
#define			dispMEM_FREE_MIN_BYTES				(4U * 1024U)	/* 最低空闲水位 (字节) */
#define			dispMEM_FRAG_MAX_PCT				(50U)			/* 最大碎片率 (%) */

//****************************************************Parameter Initialization**************************************************//
#if (boardUSE_OS)
static TaskHandle_t S_tDispTaskHandle = NULL;
#endif  //boardUSE_OS
static uint32_t S_ulMemAuditWarnCnt = 0;    /* 内存审计告警次数 (调试观测) */

//****************************************************Function Declaration******************************************************//

/***********************************************************************************************************************
 * 函数功能    : 进入项目临界区
 * 说明(备注)  : 绑定 DispOps_T.vEnterCritical; 裸机/OS 统一映射到工程临界区宏
 * 传入参数    : 无
 * 输出参数    : 无
 * 返回值      : 无
 ************************************************************************************************************************/
void vDisp_PortEnterCritical(void)
{
    mainENTER_CRITICAL();
}

/***********************************************************************************************************************
 * 函数功能    : 退出项目临界区
 * 说明(备注)  : 必须与 vDisp_PortEnterCritical 成对调用
 * 传入参数    : 无
 * 输出参数    : 无
 * 返回值      : 无
 ************************************************************************************************************************/
void vDisp_PortExitCritical(void)
{
    mainEXIT_CRITICAL();
}

/***********************************************************************************************************************
 * 函数功能    : 渲染输出原语适配
 * 说明(备注)  : 转调项目件 vDisp_UiRefresh (EEZ ui_tick -> 自绘动画 -> lv_timer_handler)
 * 传入参数    : 无
 * 输出参数    : 无
 * 返回值      : 无
 ************************************************************************************************************************/
void vDisp_PortUiRefresh(void)
{
    vDisp_UiRefresh();
}

/***********************************************************************************************************************
 * 函数功能    : 切页后内存审计 (LVGL 内存池水位/碎片率)
 * 说明(备注)  : 仅显示任务上下文调用 (LVGL 单上下文); 空闲低于阈值或碎片率超限时打印并计数,
 *               用于尽早发现页面 vOnExit 漏释放对象
 * 传入参数    : 无
 * 输出参数    : 无
 * 返回值      : 无
 ************************************************************************************************************************/
void vDisp_PortMemAudit(void)
{
    lv_mem_monitor_t t_mon;

    lv_mem_monitor(&t_mon);

    if ((t_mon.free_size < dispMEM_FREE_MIN_BYTES) || (t_mon.frag_pct > dispMEM_FRAG_MAX_PCT))
    {
        S_ulMemAuditWarnCnt++;

        if (uPrint.tFlag.bDispTask)
        {
            sMyPrint("DispMemAudit: warn=%lu free=%u frag=%u%% used=%u%%\r\n",
                     (unsigned long)S_ulMemAuditWarnCnt,
                     (unsigned int)t_mon.free_size,
                     (unsigned int)t_mon.frag_pct,
                     (unsigned int)t_mon.used_pct);
        }
    }
}

/***********************************************************************************************************************
 * 函数功能    : 背光硬件开关适配
 * 说明(备注)  : 转调项目件接口层 vDisp_SetBacklight
 * 传入参数    : on: true-点亮, false-熄灭
 * 输出参数    : 无
 * 返回值      : 无
 ************************************************************************************************************************/
void vDisp_PortSetBacklight(bool on)
{
    vDisp_SetBacklight(on);
}

/***********************************************************************************************************************
 * 函数功能    : 获取持久化自动息屏时间
 * 说明(备注)  : 息屏策略数据源 (0=常亮), 框架亮/息屏时读取
 * 传入参数    : 无
 * 输出参数    : 无
 * 返回值      : 自动息屏时间 (秒)
 ************************************************************************************************************************/
uint16_t usDisp_PortGetAutoOffTime(void)
{
    return tAppMemParam.tDISP.usAutoOffTime;
}

/***********************************************************************************************************************
 * 函数功能    : 获取毫秒时基
 * 说明(备注)  : OS 环境直接复用 FreeRTOS 节拍 (configTICK_RATE_HZ=1000 → 1 tick = 1ms);
 *               裸机项目应返回自有 1ms 计数, 返回 0 时框架退回按帧周期累计驻留时间
 * 传入参数    : 无
 * 输出参数    : 无
 * 返回值      : 毫秒时间戳
 ************************************************************************************************************************/
uint32_t ulDisp_PortGetTickMs(void)
{
    #if (boardUSE_OS)
    return (uint32_t)(xTaskGetTickCount() * portTICK_PERIOD_MS);
    #else
    return 0U;
    #endif  /* boardUSE_OS */
}

/***********************************************************************************************************************
 * 函数功能    : 系统初始化就绪判定
 * 说明(备注)  : 显示任务 INIT 页跑通后置位, 作为 INIT 步完成条件 (未就绪保持 INIT 步)
 * 传入参数    : 无
 * 输出参数    : 无
 * 返回值      : true: 系统就绪, false: 初始化未完成
 ************************************************************************************************************************/
bool bDisp_PortIsSystemReady(void)
{
    return (tSysInfo.uInit.tFinish.bIF_DispTask != 0);
}

/***********************************************************************************************************************
 * 函数功能    : overlay 激活判定适配
 * 说明(备注)  : 项目件指定 overlay 触发条件, 框架每帧电平评估压入/弹出 (本工程: 设备状态为 DS_ERR);
 *               未就绪门控: 系统初始化完成前不弹 overlay (与场景映射门控一致, 只允许 INIT 页),
 *               故障待就绪后由电平评估下一帧补入; 后续扩展只需改本函数, 通用件零修改
 * 传入参数    : p_snapshot: [IN] 帧数据快照
 * 输出参数    : 无
 * 返回值      : true: overlay 激活 (压入), false: 未激活 (可弹出)
 ************************************************************************************************************************/
bool bDisp_PortIsOverlayActive(const DispDataSnapshot_T *p_snapshot)
{
    if (p_snapshot == NULL)
        return false;

    return (bDisp_PortIsSystemReady() && (ucDisp_DataDevState(p_snapshot) == DS_ERR));
}

/***********************************************************************************************************************
 * 函数功能    : 故障 overlay 页 ID
 * 说明(备注)  : 项目件指定故障弹层页面; 框架场景调度 overlay 压入时调用
 * 传入参数    : 无
 * 输出参数    : 无
 * 返回值      : overlay 页面 ID
 ************************************************************************************************************************/
DispPageId_E eDisp_PortGetOverlayPage(void)
{
    return (DispPageId_E)PAGE_ID_FAULT;
}

/***********************************************************************************************************************
 * 函数功能    : 常亮亮屏提示钩子
 * 说明(备注)  : 框架在常亮亮屏时调用, 由项目决定提示方式 (本工程为蜂鸣提示)
 * 传入参数    : 无
 * 输出参数    : 无
 * 返回值      : 无
 ************************************************************************************************************************/
void vDisp_PortBeepOnLightOn(void)
{
    #if (boardBUZ_EN)
    bBuz_Tweet(LONG_1);
    #endif  /* boardBUZ_EN */
}

#if (boardUSE_OS)

/***********************************************************************************************************************
 * 函数功能    : 绑定显示任务句柄
 * 说明(备注)  : 显示任务创建完成后调用一次; 未绑定时唤醒为空操作
 * 传入参数    : t_handle: 显示任务句柄
 * 输出参数    : 无
 * 返回值      : 无
 ************************************************************************************************************************/
void vDisp_PortSetTaskHandle(TaskHandle_t t_handle)
{
    S_tDispTaskHandle = t_handle;
}

/***********************************************************************************************************************
 * 函数功能    : 唤醒显示任务
 * 说明(备注)  : 事件入队/背光点亮后调用; 显示任务从"通知+超时"等待中提前返回,
 *               下一轮 vDisp_EnginePoll 立即处理事件与首帧强刷
 * 传入参数    : 无
 * 输出参数    : 无
 * 返回值      : 无
 ************************************************************************************************************************/
void vDisp_PortWakeTask(void)
{
    if (S_tDispTaskHandle != NULL)
        xTaskNotifyGive(S_tDispTaskHandle);
}

#endif  //boardUSE_OS

#endif  /* boardDISPLAY_EN */
